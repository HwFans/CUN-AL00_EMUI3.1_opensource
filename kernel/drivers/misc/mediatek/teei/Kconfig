## kernel/drivers/misc/mediatek/teei/Kconfig
```kconfig
config HAVE_NEUSOFT_TEEI_SUPPORT
	bool "Enable MTK Neusoft TEEI Solution"
	default n

config NEUSOFT_TEEI_SUPPORT
	bool "Enable Neusoft TEEI Support"
	depends on HAVE_NEUSOFT_TEEI_SUPPORT
	default n
	---help---
	  Enable Neusoft TEEI Support

config NEUSOFT_TZ_DRIVER
	tristate "Neusoft TEEI Driver"
	depends on NEUSOFT_TEEI_SUPPORT
	default n
	---help---
	  Enable TEEI Linux Kernel Tz Driver

config NEUSOFT_VFS_DRIVER
	tristate "Neusoft Virtual File System Driver"
	depends on NEUSOFT_TEEI_SUPPORT
	default n
	---help---
	  Enable TEEI Virtual File System Driver

config NEUSOFT_FP_DRIVER
	tristate "Neusoft Fingerprint Driver"
	depends on NEUSOFT_TEEI_SUPPORT
	default n
config MICROTRUST_TEE_SUPPORT
	bool "Enable Microtrust TEEI Support"
	default n
	---help---
	  Enable Microtrust TEEI Support

config MICROTRUST_TZ_DRIVER
	tristate "Microtrust TEEI Driver"
	depends on MICROTRUST_TEE_SUPPORT
	default y
	---help---
	  Enable TEEI Linux Kernel Tz Driver

config MICROTRUST_VFS_DRIVER
	tristate "Microtrust Virtual File System Driver"
	depends on MICROTRUST_TEE_SUPPORT
	default y
	---help---
	  Enable TEEI Virtual File System Driver

config MICROTRUST_FP_DRIVER
	tristate "Microtrust Fingerprint Driver"
	depends on MICROTRUST_TEE_SUPPORT
	default y
	---help---
	  Enable TEEI Fingerprint Driver
```
